## conf/local.conf
```bitbake
DISTRO = "angstrom-v2012.12"
PACKAGE_CLASSES ?= "package_ipk"
BB_NUMBER_THREADS = "4"
PARALLEL_MAKE = "-j 9"
SDKMACHINE ?= "x86_64"
# Possible values : mele cubieboard olinuxino-a10 beagleboard rasberrypi n450 qemux86
MACHINE ?= "n450"
#TOPDIR := "/home/nico/src/enna-os"
TMPDIR := "${TOPDIR}/tmp"
#DL_DIR ?= "/home/nico/src/enna-os/downloads"
SSTATE_DIR ?= "${TOPDIR}/sstate-cache"
EXTRA_IMAGE_FEATURES = "debug-tweaks"
PATCHRESOLVE = "noop"
CONF_VERSION = "1"
LICENSE_FLAGS_WHITELIST = "commercial"

# SqueezeOS/SqueezePlay SCM
SQUEEZEOS_DISTRO_VERSION ?= "7.8"
SQUEEZEOS_DISTRO_RELEASE ?= "7.8.0"
SQUEEZEOS_SVN ?= "svn://svn.slimdevices.com/repos/jive/7.8/trunk/squeezeos/src;protocol=http"
SQUEEZEPLAY_SCM ?= "svn://svn.slimdevices.com/repos/jive/7.8/trunk/squeezeplay/src;protocol=http"
SQUEEZECENTER_SCM ?= "svn://svn.slimdevices.com/repos/slim/7.8;protocol=http"
```
